## main/Kconfig.projbuild
```kconfig
menu "A2DP to Dual BIS Example"

    config A2DP_BIS_DEVICE_NAME
        string "Bluetooth device / broadcast name"
        default "A2DP-2-BIS"

    config A2DP_BIS_BROADCAST_CODE
        string "Broadcast code (empty for open broadcast)"
        default ""

    choice A2DP_BIS_PCM_CVT
        prompt "PCM conversion path"
        default A2DP_BIS_PCM_CVT_ASRC if SOC_ASRC_SUPPORTED
        default A2DP_BIS_PCM_CVT_SW
        help
            Convert decoded A2DP PCM to the LC3 channel count and sample rate.
            Hardware ASRC is the default on chips that expose SOC_ASRC.
            Otherwise the software channel and rate converters are used.

        config A2DP_BIS_PCM_CVT_SW
            bool "Software channel converter + rate converter"
        config A2DP_BIS_PCM_CVT_ASRC
            bool "Hardware ASRC"
            depends on SOC_ASRC_SUPPORTED
    endchoice

    choice A2DP_BIS_LC3_PRESET
        prompt "LC3 broadcast preset"
        default A2DP_BIS_LC3_PRESET_48KHZ_10MS_155B_HQ_MONO
        help
            Default is 48 kHz, 10 ms, 155-byte, high quality: one BIG and one BIS.
            16 kHz stereo uses one BIG and two BIS (front left / front right).
            Mono presets mix A2DP stereo down to one BIS.

        config A2DP_BIS_LC3_PRESET_16KHZ_10MS_40B_HQ
            bool "16 kHz / 10 ms / 40 B / HQ, stereo (1 BIG / 2 BIS)"
        config A2DP_BIS_LC3_PRESET_16KHZ_10MS_40B_HQ_MONO
            bool "16 kHz / 10 ms / 40 B / HQ, mono (1 BIG / 1 BIS)"
        config A2DP_BIS_LC3_PRESET_48KHZ_10MS_155B_HQ_MONO
            bool "48 kHz / 10 ms / 155 B / HQ, mono (1 BIG / 1 BIS)"
    endchoice

endmenu
```

## sdkconfig.defaults
```kconfig
#
# Bootloader / flasher
#
CONFIG_BOOTLOADER_LOG_LEVEL_WARN=y
CONFIG_ESPTOOLPY_FLASHFREQ_80M=y
CONFIG_ESPTOOLPY_FLASHFREQ="80m"
CONFIG_ESPTOOLPY_FLASHMODE_QIO=y
CONFIG_ESPTOOLPY_FLASHSIZE_16MB=y
CONFIG_ESPTOOLPY_FLASHSIZE="16MB"

#
# Partition Table
#
CONFIG_PARTITION_TABLE_CUSTOM=y
CONFIG_PARTITION_TABLE_CUSTOM_FILENAME="partitions_esp32s31.csv"
CONFIG_PARTITION_TABLE_FILENAME="partitions_esp32s31.csv"
CONFIG_PARTITION_TABLE_OFFSET=0xA000

#
# FreeRTOS / compiler
#
CONFIG_FREERTOS_HZ=1000
CONFIG_FREERTOS_TASK_CREATE_ALLOW_EXT_MEM=y
CONFIG_FREERTOS_GENERATE_RUN_TIME_STATS=y
CONFIG_FREERTOS_VTASKLIST_INCLUDE_COREID=y
CONFIG_COMPILER_OPTIMIZATION_PERF=y

#
# SPIRAM
#
CONFIG_SPIRAM=y
CONFIG_SPIRAM_MODE_OCT=y
CONFIG_SPIRAM_SPEED_200M=y
CONFIG_SPIRAM_XIP_FROM_PSRAM=y
CONFIG_SPIRAM_MALLOC_ALWAYSINTERNAL=0
CONFIG_SPIRAM_TRY_ALLOCATE_WIFI_LWIP=y
CONFIG_SPIRAM_ALLOW_BSS_SEG_EXTERNAL_MEMORY=y
CONFIG_SPIRAM_ALLOW_NOINIT_SEG_EXTERNAL_MEMORY=y

#
# esp_bt_audio GMF IO
#
CONFIG_ESP_BT_AUDIO_GMF_IO_SUPPORT=y

#
# Bluetooth dual-mode Bluedroid (Classic A2DP + LE Broadcast Source)
#
CONFIG_BT_ENABLED=y
CONFIG_BT_BLUEDROID_ENABLED=y
# CONFIG_BT_NIMBLE_ENABLED is not set
CONFIG_BT_CONTROLLER_ENABLED=y
CONFIG_BTDM_CTRL_MODE_BTDM=y
CONFIG_BT_CTRL_BR_EDR_MAX_SYNC_CONN=1
CONFIG_BT_ALLOCATION_FROM_SPIRAM_FIRST=y
CONFIG_BT_BLE_DYNAMIC_ENV_MEMORY=y

CONFIG_BT_CLASSIC_ENABLED=y
CONFIG_BT_A2DP_ENABLE=y
CONFIG_BT_A2DP_USE_EXTERNAL_CODEC=y
CONFIG_BT_AVRCP_ENABLED=y
# CONFIG_BT_HFP_ENABLE is not set
# CONFIG_BT_PBAC_ENABLED is not set

CONFIG_BT_BLE_ENABLED=y
CONFIG_BT_BLE_50_FEATURES_SUPPORTED=y
CONFIG_BT_BLE_FEAT_ISO_EN=y
CONFIG_BT_BLE_FEAT_PERIODIC_ADV_SYNC_TRANSFER=y
CONFIG_BT_ACL_CONNECTIONS=2

CONFIG_BT_LE_ISO_SUPPORT=y
CONFIG_BT_ISO_MAX_CHAN=2
CONFIG_BT_BAP_BROADCAST_SOURCE=y
CONFIG_BT_BAP_BROADCAST_SRC_SUBGROUP_COUNT=1
CONFIG_BT_BAP_BROADCAST_SRC_COUNT=1
CONFIG_BT_BAP_BROADCAST_SRC_STREAM_COUNT=2
```
